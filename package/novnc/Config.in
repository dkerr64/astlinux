## package/novnc/Config.in
```kconfig
config BR2_PACKAGE_NOVNC
	bool "novnc"
	help
	  VNC client using HTML5 (Web Sockets, Canvas) with
	  encryption (wss://) support.
	  http://novnc.com
```

## package/rclone/Config.in
```kconfig
config BR2_PACKAGE_RCLONE
  bool "rclone"
  help
    rclone - rsync for cloud storage
    rclone is a command line program to sync files and
    directories to and from many cloud storage services
    http://rclone.org
```
